
#include <utils.hpp>
#include <math.h>
#include <float.h>
#include <stm32G4xx_hal.h>  // Sets up the correct chip specifc defines required by arm_math
//#define ARM_MATH_CM4 // TODO: might change in future board versions
#include "arm_math.h"
#include "arm_common_tables.h"

int SVM(float valpha, float vbeta, float vbus, float* tA, float* tB, float* tC) {
    int Sextant = 0;
    float alpha = valpha / ((2.0f / 3.0f) * vbus);
    float beta = vbeta / ((2.0f / 3.0f) * vbus);

    if (beta >= 0.0f) {
        if (alpha >= 0.0f) {
            //quadrant I
            if (one_by_sqrt3 * beta > alpha)
                Sextant = 2; //sextant v2-v3
            else
                Sextant = 1; //sextant v1-v2

        } else {
            //quadrant II
            if (-one_by_sqrt3 * beta > alpha)
                Sextant = 3; //sextant v3-v4
            else
                Sextant = 2; //sextant v2-v3
        }
    } else {
        if (alpha >= 0.0f) {
            //quadrant IV
            if (-one_by_sqrt3 * beta > alpha)
                Sextant = 5; //sextant v5-v6
            else
                Sextant = 6; //sextant v6-v1
        } else {
            //quadrant III
            if (one_by_sqrt3 * beta > alpha)
                Sextant = 4; //sextant v4-v5
            else
                Sextant = 5; //sextant v5-v6
        }
    }

    switch (Sextant) {
        // sextant v1-v2
        case 1: {
            // Vector on-times
            float t1 = alpha - one_by_sqrt3 * beta;
            float t2 = two_by_sqrt3 * beta;

            // PWM timings
            *tA = (1.0f - t1 - t2) * 0.5f;
            *tC = *tA + t1;
            *tB = *tC + t2;

            break;
        }
        // sextant v2-v3
        case 2: {
            // Vector on-times
            float t2 = alpha + one_by_sqrt3 * beta;
            float t3 = -alpha + one_by_sqrt3 * beta;

            // PWM timings
            *tC = (1.0f - t2 - t3) * 0.5f;
            *tA = *tC + t3;
            *tB = *tA + t2;

            break;
        }
        // sextant v3-v4
        case 3: {
            // Vector on-times
            float t3 = two_by_sqrt3 * beta;
            float t4 = -alpha - one_by_sqrt3 * beta;

            // PWM timings
            *tC = (1.0f - t3 - t4) * 0.5f;
            *tB = *tC + t3;
            *tA = *tB + t4;

            break;
        }
        // sextant v4-v5
        case 4: {
            // Vector on-times
            float t4 = -alpha + one_by_sqrt3 * beta;
            float t5 = -two_by_sqrt3 * beta;

            // PWM timings
            *tB = (1.0f - t4 - t5) * 0.5f;
            *tC = *tB + t5;
            *tA = *tC + t4;

            break;
        }
        // sextant v5-v6
        case 5: {
            // Vector on-times
            float t5 = -alpha - one_by_sqrt3 * beta;
            float t6 = alpha - one_by_sqrt3 * beta;

            // PWM timings
            *tB = (1.0f - t5 - t6) * 0.5f;
            *tA = *tB + t5;
            *tC = *tA + t6;

            break;
        }
        // sextant v6-v1
        case 6: {
            // Vector on-times
            float t6 = -two_by_sqrt3 * beta;
            float t1 = alpha + one_by_sqrt3 * beta;

            // PWM timings
            *tA = (1.0f - t6 - t1) * 0.5f;
            *tB = *tA + t1;
            *tC = *tB + t6;

            break;
        }
    }

    *tA = 1.0f - *tA;
    *tB = 1.0f - *tB;
    *tC = 1.0f - *tC;
    // if any of the results becomes NaN, result_valid will evaluate to false
    int result_valid =
            *tA >= 0.0f && *tA <= 1.0f
         && *tB >= 0.0f && *tB <= 1.0f
         && *tC >= 0.0f && *tC <= 1.0f;
    return result_valid ? 0 : -1;
}

#define DEFAULT_DUTY_CYCLE_LIMIT 0.97f
#define sqrtf3 1.732050807568877f

void simple_svm(float alph, float beta, float vbus, float * A, float * B, float * C) {
    float x = alph / vbus;
    float y = (-0.5f * alph - 0.5f * sqrtf3 * beta) / vbus;
    float z = (-0.5f * alph + 0.5f * sqrtf3 * beta) / vbus;

    float max = fmaxf(x, fmaxf(y, z));
    float min = fminf(x, fminf(y, z));
    float temp = 0.5f * (max + min);

    float dutyA = 0;
    float dutyB = 0;
    float dutyC = 0;

    if (max - min > 2.0f * DEFAULT_DUTY_CYCLE_LIMIT - 1.0f) {
        dutyA = (x - temp) * (2.0f * DEFAULT_DUTY_CYCLE_LIMIT - 1.0f) / (max - min) + 0.5f;
        dutyB = (y - temp) * (2.0f * DEFAULT_DUTY_CYCLE_LIMIT - 1.0f) / (max - min) + 0.5f;
        dutyC = (z - temp) * (2.0f * DEFAULT_DUTY_CYCLE_LIMIT - 1.0f) / (max - min) + 0.5f;
    } else {
        dutyA = (x - temp) + 0.5f;
        dutyB = (y - temp) + 0.5f;
        dutyC = (z - temp) + 0.5f;
    }

    *A = dutyA;
    *B = dutyB;
    *C = dutyC;
}

/**
 * \par
 * Example code for the generation of the floating-point sine table:
 * <pre>
 * tableSize = 512;
 * for(n = 0; n < (tableSize + 1); n++)
 * {
 *	sinTable[n]=sin(2*pi*n/tableSize);
 * }</pre>
 * \par
 * where pi value is  3.14159265358979
 */

const float32_t sinTable_f32[FAST_MATH_TABLE_SIZE + 1] = {
   0.00000000f, 0.01227154f, 0.02454123f, 0.03680722f, 0.04906767f, 0.06132074f,
   0.07356456f, 0.08579731f, 0.09801714f, 0.11022221f, 0.12241068f, 0.13458071f,
   0.14673047f, 0.15885814f, 0.17096189f, 0.18303989f, 0.19509032f, 0.20711138f,
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   -0.04906767f, -0.03680722f, -0.02454123f, -0.01227154f, -0.00000000f
};
